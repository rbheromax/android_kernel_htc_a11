## Kconfig
```kconfig
#
# For a description of the syntax of this configuration file,
# see Documentation/kbuild/kconfig-language.txt.
#
mainmenu "Linux/$ARCH $KERNELVERSION Kernel Configuration"

config SRCARCH
	string
	option env="SRCARCH"

source "arch/$SRCARCH/Kconfig"

config NO_ERROR_ON_MISMATCH
	bool "No error on symbol mismatches"
	default n
	help
	   Fix compile for some targets

config LTO
	bool "Link time optimizations"
	default n
	help
	   foobar
```
